## Kconfig
```kconfig
mainmenu "RT-Thread Configuration"

config $BSP_DIR
    string
    option env="BSP_ROOT"
    default "."

config $RTT_DIR
    string
    option env="RTT_ROOT"
    default "./rt-thread"

config $PKGS_DIR
    string
    option env="PKGS_ROOT"
    default "packages"

source "$RTT_DIR/Kconfig"
source "$PKGS_DIR/Kconfig"

choice
    prompt "Nordic SOC Support"
    default SOC_NRF51822_XXAC

    config SOC_NRF51822_XXAC
        bool "Enable Nrf51822 Support"

    config SOC_NRF52832_XXAA
        bool "Enable Nrf51832 Support"
endchoice
```
